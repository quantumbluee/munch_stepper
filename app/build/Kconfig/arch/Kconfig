## app/build/Kconfig/arch/Kconfig
```kconfig
# Load Zephyr Arch Kconfig descriptions.
osource "C:/Users/urvih/munch_stepper/zephyr/arch/rx/Kconfig"
osource "C:/Users/urvih/munch_stepper/zephyr/arch/x86/Kconfig"
osource "C:/Users/urvih/munch_stepper/zephyr/arch/xtensa/Kconfig"
osource "C:/Users/urvih/munch_stepper/zephyr/arch/sparc/Kconfig"
osource "C:/Users/urvih/munch_stepper/zephyr/arch/riscv/Kconfig"
osource "C:/Users/urvih/munch_stepper/zephyr/arch/posix/Kconfig"
osource "C:/Users/urvih/munch_stepper/zephyr/arch/mips/Kconfig"
osource "C:/Users/urvih/munch_stepper/zephyr/arch/arm64/Kconfig"
osource "C:/Users/urvih/munch_stepper/zephyr/arch/arm/Kconfig"
osource "C:/Users/urvih/munch_stepper/zephyr/arch/arc/Kconfig"
```

## app/build/Kconfig/boards/Kconfig.defconfig
```kconfig
# Load Zephyr board defconfig descriptions.
osource "C:/Users/urvih/munch_stepper/zephyr/boards/st/nucleo_f767zi/Kconfig.defconfig"
```

## app/tests/testcase.yaml
```yaml
tests:
  stepper.unit_tests:
    tags: unit_test
    platform_allow: native_sim
    harness: console
    harness_config:
      type: multi_line
      regex:
        - "PROJECT EXECUTION SUCCESSFUL"
```

## build/Kconfig/boards/Kconfig.sysbuild
```kconfig
# Load Sysbuild board Kconfig descriptions.
osource "C:/Users/urvih/munch_stepper/zephyr/boards/st/nucleo_f767zi/Kconfig.sysbuild"
```
