## CMakeLists.txt
```
cmake_minimum_required(VERSION 3.20.0)

find_package(Zephyr REQUIRED HINTS $ENV{ZEPHYR_BASE})
project(stepper_control)

target_sources(app PRIVATE src/main.c)

if(CONFIG_STEPPER_MOCK)
    message(STATUS "Building with MOCKED stepper driver")
    target_sources(app PRIVATE src/stepper_driver_mock.c)
else()
    message(STATUS "Building with REAL stepper driver")
    target_sources(app PRIVATE src/stepper_driver.c)
endif()
```

## Kconfig
```
source "Kconfig.zephyr"
config STEPPER_MOCK
    bool "Use mocked stepper driver"
    default n
    help
      Enable this to use the mocked stepper driver instead of real hardware.
      Useful for testing without connected hardware.
```

## prj.conf
```kconfig
CONFIG_GPIO=y
CONFIG_LOG=y
CONFIG_CONSOLE=y
CONFIG_UART_CONSOLE=y
CONFIG_SERIAL=y
CONFIG_PRINTK=y
CONFIG_CBPRINTF_FP_SUPPORT=y
```

## src/main.c
```c
#include <zephyr/kernel.h>
#include <zephyr/drivers/gpio.h>
#include <zephyr/logging/log.h>
#include "stepper_driver.h"

LOG_MODULE_REGISTER(main_app, LOG_LEVEL_INF);

// GPIO port and pin definitions
#define STEP_PORT  DT_NODELABEL(gpiob)
#define STEP_PIN   3
#define DIR_PORT   DT_NODELABEL(gpiob)
#define DIR_PIN    5
#define EN_PORT    DT_NODELABEL(gpiob)
#define EN_PIN     4

static struct stepper_t motor;

int main(void)
{
    const struct device *step_dev = DEVICE_DT_GET(STEP_PORT);
    const struct device *dir_dev = DEVICE_DT_GET(DIR_PORT);
    const struct device *en_dev  = DEVICE_DT_GET(EN_PORT);

    motor.step_pin.port = step_dev;
    motor.step_pin.pin = STEP_PIN;
    motor.step_pin.dt_flags = GPIO_ACTIVE_HIGH;

    motor.dir_pin.port = dir_dev;
    motor.dir_pin.pin = DIR_PIN;
    motor.dir_pin.dt_flags = GPIO_ACTIVE_HIGH;

    motor.en_pin.port = en_dev;
    motor.en_pin.pin = EN_PIN;
    motor.en_pin.dt_flags = GPIO_ACTIVE_HIGH;

    motor.steps_per_rev = 200;
    motor.microsteps = 16;

    LOG_INF("Munch Stepper Control App Started");

    if (stepper_init(&motor) != 0) {
        LOG_ERR("Stepper initialization failed");
        return -1;
    }

    const float angles[] = {30.0f, 45.0f, 90.0f, 180.0f};

    for (int i = 0; i < ARRAY_SIZE(angles); i++) {
        LOG_INF("Moving motor %.1f degrees", (double)angles[i]);
        stepper_move_deg(&motor, angles[i]);
        k_sleep(K_MSEC(1000));
    }

    LOG_INF("All moves completed successfully!");
    return 0;
}
```

## src/stepper_driver.c
```c
#include <zephyr/kernel.h>
#include <zephyr/logging/log.h>
#include "stepper_driver.h"

LOG_MODULE_REGISTER(stepper, LOG_LEVEL_INF);

/* Helper macro: convert degrees to step count */
#define DEG_TO_STEPS(motor, deg) ((int)((deg) / 360.0f * (motor)->steps_per_rev * (motor)->microsteps))

int stepper_init(const struct stepper_t *m)
{
    if (!device_is_ready(m->step_pin.port) ||
        !device_is_ready(m->dir_pin.port) ||
        !device_is_ready(m->en_pin.port)) {
        LOG_ERR("Stepper GPIO device not ready");
        return -ENODEV;
    }
    
    int ret;
    ret = gpio_pin_configure_dt(&m->step_pin, GPIO_OUTPUT_INACTIVE);
    if (ret != 0) {
        LOG_ERR("Failed to configure STEP pin: %d", ret);
        return ret;
    }
    
    ret = gpio_pin_configure_dt(&m->dir_pin, GPIO_OUTPUT_INACTIVE);
    if (ret != 0) {
        LOG_ERR("Failed to configure DIR pin: %d", ret);
        return ret;
    }
    
    ret = gpio_pin_configure_dt(&m->en_pin, GPIO_OUTPUT_INACTIVE);
    if (ret != 0) {
        LOG_ERR("Failed to configure EN pin: %d", ret);
        return ret;
    }

    LOG_INF("Stepper initialized (steps/rev=%d, microsteps=%d)", 
            m->steps_per_rev, m->microsteps);
    return 0;
}

int stepper_move_deg(const struct stepper_t *m, float degrees)
{
    if (degrees <= 0.0f || degrees > 360.0f) {
        LOG_WRN("Invalid input angle %.1f", (double)degrees);
        return -EINVAL;
    }

    int steps = DEG_TO_STEPS(m, degrees);
    LOG_INF("Moving %.1f degrees (%d steps)...", (double)degrees, steps);

    /* Enable driver (EN = LOW for TMC2208) */
    gpio_pin_set_dt(&m->en_pin, 0);
    k_msleep(10);  // Give driver time to wake up
    
    gpio_pin_set_dt(&m->dir_pin, 1); // CW rotation
    k_usleep(10);  // Direction setup time

    for (int i = 0; i < steps; i++) {
        gpio_pin_set_dt(&m->step_pin, 1);
        k_usleep(10);   // 10 µs HIGH (minimum for TMC2208)
        gpio_pin_set_dt(&m->step_pin, 0);
        k_usleep(1000); // 1ms LOW (slower speed = 1000 steps/sec)
    }

    /* Disable driver (EN = HIGH) */
    gpio_pin_set_dt(&m->en_pin, 1);
    LOG_INF("Move completed");
    return 0;
}
```

## src/stepper_driver.h
```c
#ifndef STEPPER_DRIVER_H_
#define STEPPER_DRIVER_H_

#include <zephyr/drivers/gpio.h>

struct stepper_t {
    struct gpio_dt_spec step_pin;
    struct gpio_dt_spec dir_pin;
    struct gpio_dt_spec en_pin;
    int steps_per_rev;
    int microsteps;
};

int stepper_init(const struct stepper_t *motor);
int stepper_move_deg(const struct stepper_t *motor, float degrees);


#endif /* STEPPER_DRIVER_H_ */
```

## src/stepper_driver_mock.c
```c
#include <zephyr/kernel.h>
#include <zephyr/logging/log.h>
#include "stepper_driver.h"

LOG_MODULE_REGISTER(stepper_mock, LOG_LEVEL_INF);

/* Helper macro: convert degrees to step count */
#define DEG_TO_STEPS(motor, deg) ((int)((deg) / 360.0f * (motor)->steps_per_rev * (motor)->microsteps))

int stepper_init(const struct stepper_t *m)
{
    LOG_INF("[MOCKED] stepper_init() called");
    LOG_INF("[MOCKED] steps_per_rev=%d, microsteps=%d", m->steps_per_rev, m->microsteps);
    return 0;
}

int stepper_move_deg(const struct stepper_t *m, float degrees)
{
    if (degrees <= 0.0f || degrees > 360.0f) {
        LOG_WRN("[MOCKED] move_stepper(%.1f degrees) - INVALID INPUT", (double)degrees);
        return -EINVAL;
    }

    int steps = DEG_TO_STEPS(m, degrees);
    LOG_INF("[MOCKED] move_stepper(%.1f degrees, %d steps) called", (double)degrees, steps);
    
    /* Simulate the time it would take */
    k_msleep(steps / 4);
    
    LOG_INF("[MOCKED] move_stepper completed");
    return 0;
}
```

## src/test.c
```c
#include <zephyr/kernel.h>
#include <zephyr/drivers/gpio.h>
#include <zephyr/logging/log.h>

LOG_MODULE_REGISTER(stepper_test, LOG_LEVEL_INF);

// Replace these with your actual GPIO PORT and PIN numbers as needed
#define STEP_PORT  DT_NODELABEL(gpiob)
#define STEP_PIN   3
#define DIR_PORT   DT_NODELABEL(gpiob)
#define DIR_PIN    5
#define EN_PORT    DT_NODELABEL(gpiob)
#define EN_PIN     4

void main(void)
{
    const struct device *step_dev = DEVICE_DT_GET(STEP_PORT);
    const struct device *dir_dev = DEVICE_DT_GET(DIR_PORT);
    const struct device *en_dev  = DEVICE_DT_GET(EN_PORT);

    gpio_pin_configure(step_dev, STEP_PIN, GPIO_OUTPUT);
    gpio_pin_configure(dir_dev, DIR_PIN, GPIO_OUTPUT);
    gpio_pin_configure(en_dev, EN_PIN, GPIO_OUTPUT);

    LOG_INF("Stepper hardware test started");

    // Set DIR (choose either HIGH or LOW for direction)
    gpio_pin_set(dir_dev, DIR_PIN, 1);

    // Enable driver
    LOG_INF("Driver EN low (should hold torque)");
    gpio_pin_set(en_dev, EN_PIN, 0);
    k_msleep(2000); // Wait 2 seconds to feel holding torque

    // Disable driver
    LOG_INF("Driver EN high (should freely rotate)");
    gpio_pin_set(en_dev, EN_PIN, 1);
    k_msleep(2000); // Wait 2 seconds for no holding torque

    // Re-enable driver for step pulse test
    LOG_INF("Driver EN low (test step pulses)");
    gpio_pin_set(en_dev, EN_PIN, 0);
    k_msleep(200);

    // Send 20 step pulses (should make motor move slightly)
    for (int i = 0; i < 20; i++) {
        gpio_pin_set(step_dev, STEP_PIN, 1);
        k_usleep(30);           // 30 µs HIGH pulse
        gpio_pin_set(step_dev, STEP_PIN, 0);
        k_usleep(1000);         // 1 ms LOW
    }

    LOG_INF("Pulse test done: repeat to diagnose.");
    k_msleep(10000); // Wait so you can observe result
}
```
